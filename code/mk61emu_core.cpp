/* 
 * This file is part of the MK61S distribution (https://gitlab.com/vitasam/mk61s).
 * Copyright (c) 2020- vitasam.
 * 
 * Based on emu145 code from F.Lazarev:
 * https://github.com/fixelsan/emu145
 * 
 * This program is free software: you can redistribute it and/or modify  
 * it under the terms of the GNU General Public License as published by  
 * the Free Software Foundation, version 3.
 *
 * This program is distributed in the hope that it will be useful, but 
 * WITHOUT ANY WARRANTY; without even the implied warranty of 
 * MERCHANTABILITY or FITNESS FOR A PARTICULAR PURPOSE. See the GNU 
 * General Public License for more details.
 *
 * You should have received a copy of the GNU General Public License 
 * along with this program. If not, see <http://www.gnu.org/licenses/>.
 */
#include <stddef.h>
#include <stdlib.h>
#include <string.h>
//#include "Arduino.h"
#include "mk61emu_core.h"
#include "debug.h"
#include "config.h"
#include "tools.hpp"
#include "rust_types.h"

typedef struct {  // Структору ПЗУ для одной микросхемы комплекта К145ИК(02,03,06)
    microinstruction_t microinstructions[68]; // микрокоманды
    instruction_t instructions[256];          // команды
} IK13_ROM;

typedef struct { // ПЗУ микрокода, микропрограмм для всего комплекта К145ИК(02,03,06) МК61
    IK13_ROM IK1302;
    IK13_ROM IK1303;
    IK13_ROM IK1306;
} mk61ROM_t;

typedef struct { // Структура микросхемы К145IИК303 
    uint8_t *pM;
    uint8_t R[IK13_MTICK_COUNT];
    uint8_t ST[IK13_MTICK_COUNT];

    io_t AMK, MOD;
    io_t S, S1, L, T, P;

    //uint16_t uI_hi;     // Instruction HI word
    uint8_t  flag_FC;
    uint8_t *pAND_AMK;  // Precalc offset from microprograms for signal_I 0..26
    uint8_t *pAND_AMK1; // Precalc offset from microprograms for signal_I 27..35
    uint16_t key_x, key_xm, key_y, comma;
}  IK1303;

typedef struct { // Структура микросхемы К145IИК306 
    //uint16_t uI_hi;  // Instruction HI word
    uint32_t AMK;

    uint32_t  L, S, S1, P, T, MOD, flag_FC;

    uint8_t   R[IK13_MTICK_COUNT];
    uint8_t   ST[IK13_MTICK_COUNT];

    uint8_t*  pAND_AMK1; // Precalc offset from microprograms for signal_I 27..35
    uint8_t*  pAND_AMK;
    uint8_t*  pM;
}  IK1306;

void IK1302_Tick(mtick_t signal_I, usize J_signal_I);
void IK1302_Clear(void);

void IK1303_Tick(mtick_t signal_I, usize J_signal_I);
void IK1303_Clear(void);

void IK1306_Tick(mtick_t signal_I, usize J_signal_I);
void IK1306_Clear(void);

/* Кольцо ДОЗУ - последовательно соединенная память комплектов микросхем К145ИК(02,03,06) в МК61 */
u8 ringM[SIZE_RING_M/*252+252+42+42+42+42*/];
const u8* END_ring_M = &ringM[SIZE_RING_M/*252+252+42+42+42+42*/];

const bool sergey_anvarov_hack_enable = true;

MK61Emu m_emu;

static const char default_symbols[16] = {
    '0', '1', '2', '3', '4', '5', '6', '7', '8', '9', '-', 'L', 'C', 'r', 'E', ' '
};

#include <array>
#if IS_CORTEX_M4() //__ARM_ARCH == 7
  #warning("Hardware mul/div present!")
#else
  #warning("Hardware mul/div unavaliable! Instantiate multiply by 9 and divide by 3 as constant table!")
  constexpr static const std::array<uint8_t, 256> div3_table = []() {
    std::array<uint8_t, 256> _{};
    for (auto i=0; i<256; i++) _[i]=i/3;
    return _;
  }();

  constexpr static const std::array<uint8_t, 256> mul9_table = []() {
    std::array<uint8_t, 256> _{};
    for (auto i=0; i<256; i++) _[i]=i*9;
    return _;
  }();
#endif

/*static std::array<uint8_t, 42+41> mod42_table = []() {
  std::array<uint8_t, 42+41> _{};
  for (auto i=0; i<42+41; i++) _[i]=i%42;
  return _;
}();*/
/*
static std::array<uint8_t, 256> __attribute__ ((aligned (16))) mod42_table = []() {
  std::array<uint8_t, 256> _{};
  for (auto i=0; i<256; i++) _[i]=i%42;
  return _;
}();
*/
static u8 __attribute__ ((aligned (16))) mod42_table[42+41];

#define DIV3(v)         (((v)*171)>>9)  //(div3_table[v]) 
//#define DIV3(v)       (((v)*171)>>9)
//#define DIV3(v)       ((v)/3)         //udiv M3/M4 

#if IS_CORTEX_M4() //__ARM_ARCH == 7
  #define MUL9(v)       ((v)*9)
#else
  #define MUL9(v)       (mul9_table[v])
//#define MUL9(v)       ((v)*9)
//#define MUL9(v)       ( ((v)+((v)<<3)) &0xff )
#endif

#define MOD42(v)       (mod42_table[v])
//#define MOD42(v)  ( ((v) %42) &0xff )

static const mk61ROM_t ROM = {
        IK1302: {
                microinstructions: {
                        0x0000000, 0x0800001, 0x0A00820, 0x0040020, // 1
                        0x0A03120, 0x0203081, 0x0A00181, 0x0803800,
                        0x0818001, 0x0800400, 0x0A00089, 0x0A03C20,
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                        0x0818180, 0x0800180, 0x0A00081, 0x0800001  //17
                },
                instructions: {
                        0x00204E4E, 0x00117360, 0x00114840, 0x01040240, // 1
                        0x00164040, 0x001B3240, 0x00064640, 0x015B4013,
                        0x00D93130, 0x00001040, 0x01A52014, 0x00000000,
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                        0x00144740, 0x01176806, 0x000A5A5A, 0x01D3200D  // 64
                }
        },
        IK1303: {
                microinstructions: {
                    0x0000000, 0x0800001, 0x0040020, 0x1440090, // 1
                        0x0A00081, 0x1000000, 0x1400020, 0x0800008,
                        0x0A03180, 0x1002200, 0x0800400, 0x1418001,
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                        0x4000020, 0x0600081, 0x1000000, 0x1000180  // 17
                },
                instructions: {
                        0x00386050, 0x005B3F3E, 0x000F5970, 0x00152470, // 1
                        0x000C3D50, 0x0011312F, 0x005B4544, 0x00165050,
                        0x000C3404, 0x005B3F3E, 0x00D40450, 0x00162424,
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                        0x0017506A, 0x00FB5020, 0x000A3C47, 0x00174D50  // 64
                }
        },
        IK1306: {
                microinstructions: {
                        0x0000000, 0x0800008, 0x0040020, 0x0800001, // 1
                        0x0800021, 0x0080020, 0x0A00028, 0x0040100,
                        0x4000100, 0x0010100, 0x0A00101, 0x0201089,
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                        0x0210081, 0x0212801, 0x0A01020, 0x0A01020  // 17
                },
                instructions: {
                        0x0070000, 0x0060040, 0x0076A2F, 0x00B4C00, // 1
                        0x0090000, 0x00B4D00, 0x0090000, 0x0055300,
                        0x0090000, 0x00B5400, 0x0090000, 0x0054600,
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                        0x1060040, 0x0074900, 0x0075F5F, 0x0094A4A  // 64
                }
        }
};

/*
const uint8_t* IK1302_M_START = &ringM[42+42];
const uint8_t* IK1303_M_START = &ringM[42];
const uint8_t* IK1306_M_START = &ringM[0];
*/

const uint8_t* IK1302_M_START = &ringM[OFFSET_IK1302/*252+42+42*/];
const uint8_t* IK1303_M_START = &ringM[OFFSET_IK1303/*252+42+42+42*/];
const uint8_t* IK1306_M_START = &ringM[OFFSET_IK1306/*252+42+42+42+42*/];

IK1302 m_IK1302;
//uint16_t IK1302_uI_hi;         // Instruction HI word
IK1303 m_IK1303;

static const uint8_t IK1302_DCW[68] = {
  0x00, 0x00, 0x00, 0x00, 0x00, 0x00, 0x00, 0x00, 0x03, 0x00, 0x00, 0x00, 0x00, 0x00, 0x00, 0x00,
  0x00, 0x02, 0x00, 0x03, 0x01, 0x00, 0x00, 0x00, 0x00, 0x00, 0x00, 0x00, 0x00, 0x00, 0x00, 0x00,
  0x02, 0x00, 0x00, 0x02, 0x00, 0x00, 0x00, 0x00, 0x00, 0x00, 0x00, 0x00, 0x00, 0x00, 0x02, 0x00,
  0x00, 0x00, 0x01, 0x00, 0x00, 0x00, 0x00, 0x00, 0x02, 0x01, 0x00, 0x00, 0x00, 0x00, 0x02, 0x02,
  0x03, 0x00, 0x00, 0x00
};

static const uint8_t IK1302_DCWA[68] = {
  0x00, 0x02, 0x0C, 0x0C, 0x0C, 0x02, 0x02, 0x00, 0x02, 0x00, 0x10, 0x0C, 0x0C, 0x0C, 0x0C, 0x0C,
  0x02, 0x02, 0x00, 0x02, 0x02, 0x02, 0x02, 0x02, 0x0A, 0x02, 0x02, 0x02, 0x02, 0x00, 0x00, 0x02,
  0x02, 0x08, 0x08, 0x00, 0x0E, 0x00, 0x00, 0x08, 0x02, 0x04, 0x08, 0x02, 0x08, 0x02, 0x06, 0x0C,
  0x04, 0x04, 0x00, 0x0A, 0x0C, 0x02, 0x00, 0x02, 0x02, 0x02, 0x0C, 0x02, 0x02, 0x0C, 0x02, 0x02,
  0x00, 0x00, 0x02, 0x02
};

static const uint8_t IK1303_DCW[68] = {
  00, 00, 00, 00, 00, 00, 00, 00, 00, 00, 00, 03, 00, 00, 00, 00,
  00, 00, 00, 02, 00, 00, 00, 00, 03, 00, 00, 00, 01, 00, 00, 00,
  00, 00, 00, 00, 00, 00, 00, 00, 00, 00, 00, 00, 00, 03, 00, 01,
  00, 03, 00, 00, 02, 00, 00, 03, 02, 00, 00, 02, 03, 00, 00, 00,
  00, 00, 00, 00
};

static const uint8_t IK1306_DCW[68] = {
  0x00, 0x00, 0x00, 0x00, 0x00, 0x00, 0x00, 0x00, 0x00, 0x02, 0x00, 0x00, 0x02, 0x00, 0x00, 0x00,
  0x00, 0x02, 0x00, 0x00, 0x00, 0x00, 0x00, 0x01, 0x00, 0x00, 0x00, 0x00, 0x00, 0x00, 0x00, 0x00,
  0x00, 0x00, 0x02, 0x00, 0x00, 0x02, 0x00, 0x00, 0x00, 0x00, 0x00, 0x00, 0x00, 0x00, 0x02, 0x02,
  0x02, 0x02, 0x03, 0x03, 0x00, 0x00, 0x00, 0x00, 0x00, 0x00, 0x00, 0x02, 0x02, 0x02, 0x02, 0x00,
  0x02, 0x02, 0x00, 0x00
};

static const uint8_t IK1302_AND_AMK[1152] = {
  0x00, 0x00, 0x00, 0x10, 0x03, 0x1D, 0x00, 0x07, 0x1E, 0x10, 0x03, 0x1C, 0x0B, 0x07, 0x0C, 0x1E,
  0x00, 0x00, 0x15, 0x18, 0x09, 0x16, 0x18, 0x09, 0x16, 0x18, 0x24, 0x00, 0x00, 0x00, 0x00, 0x00,
  0x00, 0x00, 0x00, 0x00, 0x00, 0x03, 0x0E, 0x1E, 0x33, 0x00, 0x00, 0x00, 0x00, 0x23, 0x00, 0x00,
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  0x08, 0x36, 0x00, 0x08, 0x12, 0x00, 0x00, 0x03, 0x1E, 0x0F, 0x26, 0x0A, 0x02, 0x26, 0x40, 0x08
};

static const uint8_t IK1303_AND_AMK[1152] = {
  0x2C, 0x23, 0x00, 0x2C, 0x23, 0x00, 0x2C, 0x23, 0x30, 0x31, 0x32, 0x00, 0x31, 0x32, 0x12, 0x31,
  0x32, 0x30, 0x00, 0x00, 0x00, 0x11, 0x23, 0x00, 0x1F, 0x06, 0x00, 0x31, 0x00, 0x1C, 0x31, 0x00,
  0x00, 0x31, 0x08, 0x1D, 0x2C, 0x02, 0x0E, 0x2C, 0x02, 0x01, 0x2C, 0x02, 0x08, 0x08, 0x3A, 0x00,
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  0x05, 0x06, 0x3C, 0x05, 0x06, 0x00, 0x00, 0x06, 0x0C, 0x0C, 0x00, 0x00, 0x12, 0x24, 0x1D, 0x1D
};

static const uint8_t IK1306_AND_AMK[1152] = {
  0x00, 0x00, 0x00, 0x00, 0x00, 0x00, 0x00, 0x00, 0x00, 0x2C, 0x2A, 0x27, 0x13, 0x2B, 0x27, 0x13,
  0x2B, 0x27, 0x34, 0x2A, 0x27, 0x13, 0x2B, 0x27, 0x13, 0x2B, 0x27, 0x29, 0x2A, 0x35, 0x29, 0x2B,
  0x35, 0x29, 0x2B, 0x35, 0x29, 0x12, 0x35, 0x29, 0x42, 0x35, 0x29, 0x42, 0x35, 0x2E, 0x00, 0x00,
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  0x42, 0x42, 0x42, 0x42, 0x42, 0x42, 0x42, 0x42, 0x42, 0x42, 0x42, 0x42, 0x42, 0x42, 0x42, 0x42
};

IK1306 m_IK1306;

//TODO: remove me static
inline void __attribute__((always_inline)) _CycleE(int J_signal_I, mtick_t &signal_I) {
	IK1302_Tick(signal_I, J_signal_I);
	IK1303_Tick(signal_I, J_signal_I);
	IK1306_Tick(signal_I, J_signal_I);
}


//TODO: remove me
inline void __attribute__((always_inline)) _CycleB(int J_signal_I, mtick_t &signal_I) {
	_CycleE(J_signal_I, signal_I);
	signal_I++;
}

#define CycleE(J_signal_I)	_CycleE(J_signal_I, signal_I)
#define CycleB(J_signal_I)	_CycleB(J_signal_I, signal_I)

#ifdef out_dump

uint16_t step = 0;

void dumpm(uint16_t sig, uint16_t cyc) {
 uint16_t i;
        printf("st %2.2d cy %3.3d si %2.2d\n(%d,%d)1302 R dump:\n",step,cyc,sig,IK1302_key_x,IK1302_key_y);
        for(i=0;i<42;i++){
                if((i % 15) == 0) printf("\n%2.2X ", i);
                printf("%2.2X ", IK1302_R[i]);
        }/*
        printf("\n\nIK1302 M dump: \n\n");
        for(i=0;i<42;i++){
                if((i % 15) == 0) printf("\n\n %4.4X ", i);
                printf("%2.2X ", m_IK1302.M[i]);
        }*/
        printf("\n1303 R dump:\n");
        for(i=0;i<42;i++){
                if((i % 15) == 0) printf("\n%2.2X ", i);
                printf("%2.2X ", m_IK1303.R[i]);
        }/*
        printf("\n\nIK1303 M dump: \n\n");
        for(i=0;i<42;i++){
                if((i % 15) == 0) printf("\n\n %4.4X ", i);
                printf("%2.2X ", m_IK1303.M[i]);
        }*/
        printf("\n1306 R dump:\n");
        for(i=0;i<42;i++){
                if((i % 15) == 0) printf("\n%2.2X ", i);
                printf("%2.2X ", IK1306_R[i]);
        }/*
        printf("\n\nIK1306 M dump: \n\n");
        for(i=0;i<42;i++){
                if((i % 15) == 0) printf("\n\n %4.4X ", i);
                printf("%2.2X ", m_IK1306.M[i]);
        }

                        printf("\n\nIR2.1 M dump: \n\n");
                        for(i=0;i<252;i++){
                                if((i % 15) == 0) printf("\n\n %4.4X ", i);
                                printf("%2.2X ", IR2_1.M[i]);
                        }
                        printf("\n\nIR2.2 M dump: \n\n");
                        for(i=0;i<252;i++){
                                if((i % 15) == 0) printf("\n\n %4.4X ", i);
                                printf("%2.2X ", IR2_2.M[i]);
                        }*/
        puts("\n");
}
#endif

inline usize IK1302_GoZero(void) {
    uint32_t uI = ROM.IK1302.instructions[(uint16_t)m_IK1302.R[36] + 16 * (uint16_t)m_IK1302.R[39]];
    const usize IK1302_uI_hi = uI >> 16;


    m_IK1302.pAND_AMK = (uint8_t*) &IK1302_AND_AMK[MUL9((uint8_t) uI)];
    m_IK1302.pAND_AMK1 = (uint8_t*) &IK1302_AND_AMK[MUL9((((uint16_t) uI) >> 8))];

    m_IK1302.MOD = (uint8_t) (uI >> 24);
    m_IK1302.flag_FC = IK1302_uI_hi & 0x00FC;
    if (m_IK1302.flag_FC== 0) m_IK1302.T = 0;

    m_IK1302.key_xm = m_IK1302.key_x - 1;
  
  return IK1302_uI_hi;
}

inline usize IK1303_GoZero(void) {
    uint32_t uI = ROM.IK1303.instructions[(uint16_t)m_IK1303.R[36] + 16 * (uint16_t)m_IK1303.R[39]];
    const usize IK1303_uI_hi = uI >> 16;

    m_IK1303.pAND_AMK = (uint8_t*) &IK1303_AND_AMK[ MUL9((uint8_t) uI) ];
    m_IK1303.pAND_AMK1 = (uint8_t*) &IK1303_AND_AMK[ MUL9((((uint16_t) uI) >> 8)) ];

    m_IK1303.MOD = (uint8_t) (uI >> 24);
    m_IK1303.flag_FC = IK1303_uI_hi & 0x00FC;
    if (m_IK1303.flag_FC == 0) m_IK1303.T = 0;

    m_IK1303.key_xm = m_IK1303.key_x - 1;
  
  return IK1303_uI_hi;
}

inline usize IK1306_GoZero(void) {
    uint32_t uI = ROM.IK1306.instructions[m_IK1306.R[36] + 16 * m_IK1306.R[39]];
    const usize IK1306_uI_hi = uI >> 16;

    m_IK1306.pAND_AMK = (uint8_t*) &IK1306_AND_AMK[MUL9((uint8_t) uI)];
    m_IK1306.pAND_AMK1 = (uint8_t*) &IK1306_AND_AMK[MUL9((((uint16_t) uI) >> 8))];

    m_IK1306.MOD = (uint8_t) (uI >> 24);

  return IK1306_uI_hi;
}

void cycle(void) {
  mtick_t signal_I;
  const int MAX_CYCLE = (sergey_anvarov_hack_enable)? 280 : 560;
  for (int count = 1; count <= MAX_CYCLE; count++){
      signal_I = 0;

      const u8 IK1302_uI_hi = (u8) IK1302_GoZero();
      const u8 IK1303_uI_hi = (u8) IK1303_GoZero();
      const u8 IK1306_uI_hi = (u8) IK1306_GoZero();

      dbghexln(CORE61, "IK1302.IP = 0x", (u16) m_IK1302.R[36] + 16 * (u16) m_IK1302.R[39]);

      #ifdef out_dump
      dumpm(signal_I, count);
      #endif

          #pragma GCC unroll 99	//TODO: remove me
          for (auto _ : {0,1,2,3,4,5, 3,4,5,3,4,5, 3,4,5,3,4,5, 3,4,5,3,4,5, 6,7,8}) { CycleB(_); }	//0..26

          m_IK1302.pAND_AMK = m_IK1302.pAND_AMK1;
          m_IK1303.pAND_AMK = m_IK1303.pAND_AMK1;
          m_IK1306.pAND_AMK = m_IK1306.pAND_AMK1;

          #pragma GCC unroll 99	//TODO: remove me
          for (auto _ : {0,1,2, 3,4,5,6,7,8}) { CycleB(_); }	//27..35

      // signal == 36
      if (IK1302_uI_hi > 0x1f)
      {
          m_IK1302.R[37] = IK1302_uI_hi & 0xf;   // signal == 36
          m_IK1302.R[40] = IK1302_uI_hi >> 4;    // signal == 36
          m_IK1302.pAND_AMK  = (uint8_t*) &IK1302_AND_AMK[0x5f * 9];
      }
      else{
          m_IK1302.pAND_AMK  = (uint8_t*) &IK1302_AND_AMK[MUL9(IK1302_uI_hi)];
      }

      if (IK1303_uI_hi > 0x1f)
      {
          m_IK1303.R[37] = (IK1303_uI_hi) & 0xf;   // signal == 36
          m_IK1303.R[40] = (IK1303_uI_hi) >> 4;    // signal == 36
          m_IK1303.pAND_AMK  = (uint8_t*) &IK1303_AND_AMK[0x5f * 9];
      }
      else{
           m_IK1303.pAND_AMK  = (uint8_t*) &IK1303_AND_AMK[MUL9(IK1303_uI_hi)];
      }

      if (IK1306_uI_hi > 0x1f)
      {
          m_IK1306.R[37] = (IK1306_uI_hi) & 0xf;   // signal == 36
          m_IK1306.R[40] = (IK1306_uI_hi) >> 4;    // signal == 36
          m_IK1306.pAND_AMK  = (uint8_t*) &IK1306_AND_AMK[0x5f * 9];
      }
      else{
          m_IK1306.pAND_AMK  = (uint8_t*) &IK1306_AND_AMK[MUL9(IK1306_uI_hi)];
      }

          CycleB(0);   // 36
          CycleB(1);   // 37
          CycleB(2);   // 38
          CycleB(3);   // 39
          CycleB(4);
          CycleE(5);    // 41

          m_IK1302.pM += 42;
          m_IK1303.pM += 42;
          m_IK1306.pM += 42;
          if(m_IK1302.pM == END_ring_M/*&ringM[252+252+42+42+42]*/){
                  m_IK1302.pM = &ringM[0];
          }
          else if(m_IK1303.pM == END_ring_M/*&ringM[252+252+42+42+42]*/){
                  m_IK1303.pM = &ringM[0];
          }
          else if(m_IK1306.pM == END_ring_M/*&ringM[252+252+42+42+42]*/){
                   m_IK1306.pM = &ringM[0];
          }
  }
#ifdef out_dump
  step++;
#endif
}

void IK1302_Tick(mtick_t signal_I, usize J_signal_I)
{
 uint32_t  microinstruction;
 uint32_t  val, tmp;
 uint32_t  mi_hi;

// Вывод дампа отладочной информации 
  dbg(CORE61, "I:", signal_I, " J:",  J_signal_I, " 1302.R[");
  for(u8 R : m_IK1302.R) dbghex(CORE61, ".", R);
  dbg(CORE61, "]\n 1302.ST[");
  for(u8 ST : m_IK1302.ST) dbghex(CORE61, ".", ST);
  dbghexln(CORE61, "]\n pM = $", (usize) m_IK1302.pM - (usize) &ringM[0], " pAND_AMK = $", (usize) m_IK1302.pAND_AMK - (usize) IK1302_AND_AMK, " pAND_AMK1 = $", (usize) m_IK1302.pAND_AMK1 - (usize) IK1302_AND_AMK);
  dbghexln(CORE61, "AMK = ", m_IK1302.AMK);
  dbghex(CORE61, "FLAGS L ", m_IK1302.L);
  dbghex(CORE61, ":S ", m_IK1302.S);
  dbghex(CORE61, ":S1 ", m_IK1302.S1);
  dbghex(CORE61, ":P ", m_IK1302.P);
  dbghex(CORE61, ":T ", m_IK1302.T);
  dbghex(CORE61, ":MOD ", m_IK1302.MOD);
  dbghexln(CORE61, ":flag_FC ", m_IK1302.flag_FC);


    tmp = (uint8_t) m_IK1302.pAND_AMK[J_signal_I];
    if (tmp > 59 && m_IK1302.L == 0){ // Если AMK больше 59 (60,61,62,63), то пересчитываются (60,62,64,66) или (61,63,65,67) при L=0
       tmp++;
    }
    microinstruction = ROM.IK1302.microinstructions[tmp];
    m_IK1302.AMK = tmp;

    mi_hi = (microinstruction >> 16);
 //---------------------------------------------------------
    if((((microinstruction >> 24) & 0x03) == 0x2) || (((microinstruction >> 24) & 0x03) == 0x3)) {
        if (DIV3(signal_I) != m_IK1302.key_xm)
           m_IK1302.S1 |= m_IK1302.key_y;
    }
 //---------------------------------------------------------
    io_t alpha = 0;
    io_t gamma = 0;
    io_t sigma = 0;

    if((microinstruction & 0x7FFF) != 0){
        switch(IK1302_DCWA[tmp/*m_IK1302.AMK*/]) {
                case 0: alpha = 0; break;
                case 0x0002: alpha = m_IK1302.R[signal_I]; break;
                case 0x0004: alpha = m_IK1302.pM[signal_I]; break;
                case 0x0006: alpha = m_IK1302.ST[signal_I]; break;
                case 0x0008: alpha = ~m_IK1302.R[signal_I] & 0xf; break;
                case 0x000A: if (m_IK1302.L == 0) alpha = 0xa; else alpha = 0; break;
                case 0x000C: alpha = m_IK1302.S; break;
                case 0x000E: alpha = 4; break;
                case 0x0010: alpha = 0xf;
        }

        if((microinstruction & 0x0F80) != 0) {
          switch(microinstruction & 0x0F80) {
                case 0x0800: alpha += 1; break;
                case 0x0400: alpha += 6; break;
                case 0x0C00: alpha += (1|6); break;
                case 0x0080: alpha += m_IK1302.S; break;
                case 0x0100: alpha += (~m_IK1302.S & 0xf); break;
                case 0x0200: alpha += m_IK1302.S1; break;
                case 0x0180: alpha += 0xf; break;
                case 0x0280: alpha += (m_IK1302.S | m_IK1302.S1); break;
          }
        }
   //---------------------------------------------------------
        if (m_IK1302.flag_FC > 0){
                if (m_IK1302.key_y == 0) m_IK1302.T = 0;
        } else {
                m_IK1302.displayed = 1;
                val = DIV3(signal_I);
                if((val == m_IK1302.key_xm) && (m_IK1302.key_y != 0)){
                                m_IK1302.S1 = m_IK1302.key_y;
                                m_IK1302.T = 1;
                }
                if((val < 12) && (m_IK1302.L != 0)) m_IK1302.comma = val;
        }
   //---------------------------------------------------------
        if((microinstruction & 0x4000) != 0) gamma = m_IK1302.T ^ 1; else gamma = 0;
        if((microinstruction & 0x2000) != 0) gamma |= m_IK1302.L ^ 1;
        if((microinstruction & 0x1000) != 0) gamma |= m_IK1302.L;

        alpha += gamma;
        sigma = alpha & 0xf;
        m_IK1302.P = alpha >> 4;
    } else {
   //---------------------------------------------------------
        if (m_IK1302.flag_FC > 0){
                if (m_IK1302.key_y == 0) m_IK1302.T = 0;
        } else {
                m_IK1302.displayed = 1;
                val = DIV3(signal_I);
                if((val == m_IK1302.key_xm) && (m_IK1302.key_y != 0)){
                                m_IK1302.S1 = m_IK1302.key_y;
                                m_IK1302.T = 1;
                }
                if((val < 12) && (m_IK1302.L != 0)) m_IK1302.comma = val;
        }
    //---------------------------------------------------------
        sigma = 0;
        m_IK1302.P = 0;
    }
#ifdef out_dump
printf("AMK %4.4X, microinstruction: %8.8X, MOD %u, S %u, S1 %u, sigma %u\n", m_IK1302.AMK, microinstruction, IK1302_MOD, IK1302_S, IK1302_S1, sigma);
#endif
//---------------------------------------------------------
    if (m_IK1302.MOD == 0 || signal_I >= 36) {
        tmp = IK1302_DCW[tmp/*m_IK1302.AMK*/];
        if(tmp != 0){
          switch (tmp) {
            case 1: 
                dbgln(CORE61, "R[", signal_I, "] = R[", MOD42(signal_I + 3));
                m_IK1302.R[signal_I] = m_IK1302.R[MOD42(signal_I + 3)]; 
              break;
            case 2: m_IK1302.R[signal_I] = sigma; break;
            case 3: m_IK1302.R[signal_I] = m_IK1302.S; break;
            case 4: m_IK1302.R[signal_I] = m_IK1302.R[signal_I] | m_IK1302.S | sigma; break;
            case 5: m_IK1302.R[signal_I] = m_IK1302.S | sigma; break;
            case 6: m_IK1302.R[signal_I] = m_IK1302.R[signal_I] | m_IK1302.S; break;
            case 7: m_IK1302.R[signal_I] = m_IK1302.R[signal_I] | sigma;
          }
        }

        if ((mi_hi & 0x0004) !=0)    m_IK1302.R[MOD42(signal_I + 41)] = sigma;
        if ((mi_hi & 0x0008) !=0)    m_IK1302.R[MOD42(signal_I + 40)] = sigma;
    }
    if ((mi_hi & 0x0020) !=0)        m_IK1302.L = m_IK1302.P & 1;
    if ((mi_hi & 0x0010) !=0)        m_IK1302.pM[signal_I] = m_IK1302.S;
//---------------------------------------------------------

        if((mi_hi & 0x0040) == 0){
         // 6 bit == 0, может быть 7 бит не равен?
          if((mi_hi & 0x0080) != 0)  m_IK1302.S = sigma; // 7 bit == 1
        } else {
         // 6 bit == 1, может быть 7 бит тоже равен?
                m_IK1302.S = m_IK1302.S1;
          if((mi_hi & 0x0080) != 0) m_IK1302.S |= sigma;
        }

        // 6 bit == 0, нам пофиг на состояние 7 бита
        if((mi_hi & 0x0100) != 0){
         // 6 bit == 1, может быть 7 бит тоже равен?
          if((mi_hi & 0x0200) != 0) m_IK1302.S1 |= sigma; else m_IK1302.S1 = sigma;
        }
//----------------------------------------------------------
    mi_hi = mi_hi & 0x0C00;
    if(mi_hi != 0){
          if(mi_hi == 0x0400) {
                    m_IK1302.ST[MOD42(signal_I + 2)] = m_IK1302.ST[MOD42(signal_I + 1)];
                    m_IK1302.ST[MOD42(signal_I + 1)] = m_IK1302.ST[signal_I];
                    m_IK1302.ST[signal_I] = sigma;
          } else if(mi_hi == 0x0800) {
                    tmp = m_IK1302.ST[signal_I];
                    m_IK1302.ST[signal_I] = m_IK1302.ST[MOD42(signal_I + 1)];
                    m_IK1302.ST[MOD42(signal_I + 1)] = m_IK1302.ST[MOD42(signal_I + 2)];
                    m_IK1302.ST[MOD42(signal_I + 2)] = tmp;
          }
    }
}

//uint8_t IK1302_DCWA[68];
void IK1302_Clear(void) {
    m_IK1302.pM = (uint8_t*) IK1302_M_START;
    memset(m_IK1302.R, 0, sizeof(m_IK1302.R));
    memset(m_IK1302.ST, 0, sizeof(m_IK1302.ST));
    m_IK1302.AMK = 0;
    m_IK1302.key_y = 0;
    m_IK1302.key_x = 0;
    m_IK1302.comma = 0;
    m_IK1302.S = 0;
    m_IK1302.S1 = 0;
    m_IK1302.L = 0;

    m_IK1302.T = 0;
    m_IK1302.P = 0;
    m_IK1302.MOD = 0;
    m_IK1302.pAND_AMK = (uint8_t*) &IK1302_AND_AMK[0];
    m_IK1302.pAND_AMK1 = (uint8_t*) &IK1302_AND_AMK[0];
}

void IK1303_Clear(void)
{
    m_IK1303.pM = (uint8_t*)IK1303_M_START;
    memset(m_IK1303.R, 0, sizeof(m_IK1303.R));
    memset(m_IK1303.ST, 0, sizeof(m_IK1303.ST));
    m_IK1303.S = 0;
    m_IK1303.S1 = 0;
    m_IK1303.L = 0;
    m_IK1303.P = 0;
    m_IK1303.T = 0;
    m_IK1303.key_x = 0;
    m_IK1303.key_y = 0;
    m_IK1303.comma = 0;
    m_IK1303.AMK = 0;
    m_IK1303.MOD = 0;
    m_IK1303.pAND_AMK   = (uint8_t*) &IK1303_AND_AMK[0];
    m_IK1303.pAND_AMK1  = (uint8_t*) &IK1303_AND_AMK[0];
}

void IK1303_Tick(mtick_t signal_I, usize J_signal_I)
{
 uint32_t tmp;
 uint32_t microinstruction;
 uint32_t mi_hi;

 tmp = (uint8_t) m_IK1303.pAND_AMK[J_signal_I];
 if (tmp > 59 && m_IK1303.L == 0){ // Если AMK больше 59 (60,61,62,63), то пересчитываются (60,62,64,66) или (61,63,65,67) при L=0
      tmp++;
 }

 microinstruction = ROM.IK1303.microinstructions[tmp];
 m_IK1303.AMK = tmp;

 mi_hi = (microinstruction >> 16);
//---------------------------------------------------------
 if((((microinstruction >> 24) & 0x03) == 0x2) || (((microinstruction >> 24) & 0x03) == 0x3)) {
     if (DIV3(signal_I) != m_IK1303.key_xm) {
         // TODO remove if (m_IK1303.key_y > 0)
         m_IK1303.S1 |= m_IK1303.key_y;
     }
 }
//---------------------------------------------------------
   io_t alpha = 0;
   io_t gamma = 0;
   io_t sigma = 0;
   if((microinstruction & 0x7FFF) != 0){

        switch(microinstruction & 0x007F){
                case 0x0001: alpha = m_IK1303.R[signal_I]; break;
                case 0x0002: alpha = m_IK1303.pM[signal_I]; break;
                case 0x0004: alpha = m_IK1303.ST[signal_I]; break;
                case 0x0008: alpha = ~m_IK1303.R[signal_I] & 0xf; break;
                case 0x0009: alpha = 0xf; break;
                case 0x0010: if (m_IK1303.L == 0) alpha = 0xa; else alpha = 0; break;
                case 0x0020: alpha = m_IK1303.S; break;
                case 0x0040: alpha = 4; break;
                case 0: alpha = 0;
        }

        if((microinstruction & 0x0F80) != 0){
          switch(microinstruction & 0x0F80){
                case 0x0800: alpha += 1; break;
                case 0x0400: alpha += 6; break;
                case 0x0C00: alpha += 1|6; break;
                case 0x0080: alpha += m_IK1303.S; break;
                case 0x0100: alpha += ~m_IK1303.S & 0xf; break;
                case 0x0200: alpha += m_IK1303.S1; break;
                case 0x0180: alpha += 0xf; break;
                case 0x0280: alpha += m_IK1303.S | m_IK1303.S1; break;
                case 0x0500: alpha += 6 | (~m_IK1303.S & 0xf); break;
          }
    }
   //---------------------------------------------------------
        if (m_IK1303.flag_FC > 0){
                if (m_IK1303.key_y == 0) m_IK1303.T = 0;
        }
        else{
                tmp = DIV3(signal_I);
                if (tmp == m_IK1303.key_xm)
                        if (m_IK1303.key_y > 0) {
                                m_IK1303.S1 = m_IK1303.key_y;
                                m_IK1303.T = 1;
                        }
                if (tmp < 12) if (m_IK1303.L > 0)  m_IK1303.comma = tmp;
        }
   //---------------------------------------------------------
        if((microinstruction & 0x4000) != 0) gamma = m_IK1303.T ^ 1; else gamma = 0;
        if((microinstruction & 0x2000) != 0) gamma |= m_IK1303.L ^ 1;
        if((microinstruction & 0x1000) != 0) gamma |= m_IK1303.L;

        alpha +=gamma;
        sigma = alpha & 0xf;
        m_IK1303.P = alpha >> 4;
   }
   else{
     //---------------------------------------------------------
        if (m_IK1303.flag_FC > 0){
                if (m_IK1303.key_y == 0) m_IK1303.T = 0;
        }
        else{
                tmp = DIV3(signal_I);
                if (tmp == m_IK1303.key_xm)
                        if (m_IK1303.key_y > 0) {
                                m_IK1303.S1 = m_IK1303.key_y;
                                m_IK1303.T = 1;
                        }
                if (tmp < 12) if (m_IK1303.L > 0)  m_IK1303.comma = tmp;
        }
   //---------------------------------------------------------
        sigma = 0;
        m_IK1303.P = 0;
   }
#ifdef out_dump
printf("AMK %4.4X, microinstruction: %8.8X, MOD %u, S %u, S1 %u, sigma %u\n", m_IK1303.AMK, microinstruction, m_IK1303.MOD, m_IK1303.S, m_IK1303.S1, sigma);
#endif
//---------------------------------------------------------
    if (m_IK1303.MOD == 0 || signal_I >= 36)
    {
        tmp = IK1303_DCW[m_IK1303.AMK];
                if(tmp != 0){
          switch (tmp)
          {
            case 1: m_IK1303.R[signal_I] = m_IK1303.R[MOD42(signal_I + 3)]; break;
            case 2: m_IK1303.R[signal_I] = sigma; break;
            case 3: m_IK1303.R[signal_I] = m_IK1303.S; break;
            case 4: m_IK1303.R[signal_I] = m_IK1303.R[signal_I] | m_IK1303.S | sigma; break;
            case 5: m_IK1303.R[signal_I] = m_IK1303.S | sigma; break;
            case 6: m_IK1303.R[signal_I] = m_IK1303.R[signal_I] | m_IK1303.S; break;
            case 7: m_IK1303.R[signal_I] = m_IK1303.R[signal_I] | sigma; break;
          }
                }

        if ((mi_hi & 0x0004) !=0)    m_IK1303.R[MOD42(signal_I + 41)] = sigma;
        if ((mi_hi & 0x0008) !=0)    m_IK1303.R[MOD42(signal_I + 40)] = sigma;
    }
    if ((mi_hi & 0x0020) !=0)        m_IK1303.L = m_IK1303.P & 1;
    if ((mi_hi & 0x0010) !=0)        m_IK1303.pM[signal_I] = m_IK1303.S;
//---------------------------------------------------------

        if((mi_hi & 0x0040) == 0){
         // 6 bit == 0, может быть 7 бит не равен?
          if((mi_hi & 0x0080) != 0)  m_IK1303.S = sigma; // 7 bit == 1
        }
        else{
         // 6 bit == 1, может быть 7 бит тоже равен?
          m_IK1303.S = m_IK1303.S1;
          if((mi_hi & 0x0080) != 0) m_IK1303.S |= sigma;
        }

         // 6 bit == 0, нам пофиг на состояние 7 бита
        if((mi_hi & 0x0100) != 0){
         // 6 bit == 1, может быть 7 бит тоже равен?
          if((mi_hi & 0x0200) != 0) m_IK1303.S1 |= sigma; else m_IK1303.S1 = sigma;
        }
//----------------------------------------------------------
    mi_hi = mi_hi & 0x0C00;
    if(mi_hi != 0){
          if(mi_hi == 0x0400){
                    m_IK1303.ST[MOD42(signal_I + 2)] = m_IK1303.ST[MOD42(signal_I + 1)];
                    m_IK1303.ST[MOD42(signal_I + 1)] = m_IK1303.ST[signal_I];
                    m_IK1303.ST[signal_I] = sigma;
          }
          else if(mi_hi == 0x0800){
                    tmp = m_IK1303.ST[signal_I];
                    m_IK1303.ST[signal_I] = m_IK1303.ST[MOD42(signal_I + 1)];
                    m_IK1303.ST[MOD42(signal_I + 1)] = m_IK1303.ST[MOD42(signal_I + 2)];
                    m_IK1303.ST[MOD42(signal_I + 2)] = tmp;
          }
    }
}

void IK1306_Clear(void)
{
    m_IK1306.pM = (uint8_t*)IK1306_M_START;
    memset(m_IK1306.R, 0, sizeof(m_IK1306.R));
    memset(m_IK1306.ST, 0, sizeof(m_IK1306.ST));
    m_IK1306.S = 0;
    m_IK1306.S1 = 0;
    m_IK1306.L = 0;
    m_IK1306.P = 0;
    m_IK1306.AMK = 0;
    m_IK1306.MOD = 0;
    m_IK1306.pAND_AMK   = (uint8_t*) &IK1306_AND_AMK[0];
    m_IK1306.pAND_AMK1  = (uint8_t*) &IK1306_AND_AMK[0];
}

void IK1306_Tick(mtick_t signal_I, usize J_signal_I)
{
    uint32_t tmp, mi_hi;
    uint32_t microinstruction;

    tmp = (uint8_t) m_IK1306.pAND_AMK[J_signal_I];            //    AMK = AND_AMK[ASPx9 + J_signal_I];
    if (tmp > 59 && m_IK1306.L == 0){                         // Если AMK больше 59 (60,61,62,63), то пересчитываются (60,62,64,66) или (61,63,65,67) при L=0
        tmp++;
    }
    microinstruction = ROM.IK1306.microinstructions[tmp];
    m_IK1306.AMK = tmp;


    mi_hi = (microinstruction >> 16);
//---------------------------------------------------------
    io_t alpha = 0;
    io_t gamma = 0;
    io_t sigma = 0;
    if((microinstruction & 0x3FFF) != 0){
        switch(microinstruction & 0x007F) {
                case 0x0001: alpha = m_IK1306.R[signal_I]; break;
                case 0x0002: alpha = m_IK1306.pM[signal_I]; break;
                case 0x0004: alpha = m_IK1306.ST[signal_I]; break;
                case 0x0005: alpha = m_IK1306.ST[signal_I] | m_IK1306.R[signal_I]; break;
                case 0x0008: alpha = ~m_IK1306.R[signal_I] & 0xf; break;
                case 0x0009: alpha = 0xf; break;
                case 0x0010: if(m_IK1306.L == 0) alpha = 0xa; else alpha = 0; break;
                case 0x0020: alpha = m_IK1306.S; break;
                case 0x0021: alpha = m_IK1306.S | m_IK1306.R[signal_I]; break;
                case 0x0028: alpha = m_IK1306.S | (~m_IK1306.R[signal_I] & 0xf); break;
                case 0x0040: alpha = 4; break;
                case 0: alpha = 0;
        }

        if((microinstruction & 0x0F80) != 0) {
           switch(microinstruction & 0x0F80) {
             case 0x0800: alpha += 1; break;
             case 0x0400: alpha += 6; break;
             case 0x0C00: alpha += 1|6; break;
             case 0x0080: alpha += m_IK1306.S; break;
             case 0x0100: alpha += ~m_IK1306.S & 0xf; break;
             case 0x0200: alpha += m_IK1306.S1; break;
             case 0x0180: alpha += m_IK1306.S | (~m_IK1306.S & 0xf); break;
           }
        }
 //---------------------------------------------------------
     if((microinstruction & 0x2000) != 0) gamma = m_IK1306.L ^ 1; else gamma=0;
     if((microinstruction & 0x1000) != 0) gamma |= m_IK1306.L;

     alpha += gamma;
     sigma = alpha & 0xf;
     m_IK1306.P = alpha >> 4;
    }
    else{
            sigma = 0;
           m_IK1306.P = 0;
    }
#ifdef out_dump
printf("AMK %4.4X, microinstruction: %8.8X, MOD %u, S %u, S1 %u, sigma %u\n", m_IK1306.AMK, microinstruction, IK1306_MOD, IK1306_S, IK1306_S1, sigma);
#endif
//---------------------------------------------------------
    if (m_IK1306.MOD == 0 || signal_I >= 36)
    {
        tmp = IK1306_DCW[m_IK1306.AMK];
        if(tmp != 0){
          switch (tmp){
            case 1: m_IK1306.R[signal_I] = m_IK1306.R[MOD42(signal_I + 3)]; break;
            case 2: m_IK1306.R[signal_I] = sigma; break;
            case 3: m_IK1306.R[signal_I] = m_IK1306.S; break;
            case 4: m_IK1306.R[signal_I] = m_IK1306.R[signal_I] | m_IK1306.S | sigma; break;
            case 5: m_IK1306.R[signal_I] = m_IK1306.S | sigma; break;
            case 6: m_IK1306.R[signal_I] = m_IK1306.R[signal_I] | m_IK1306.S; break;
            case 7: m_IK1306.R[signal_I] = m_IK1306.R[signal_I] | sigma; break;
          }
        }

        if ((mi_hi & 0x0004) !=0)    m_IK1306.R[MOD42(signal_I + 41)] = sigma;
        if ((mi_hi & 0x0008) !=0)    m_IK1306.R[MOD42(signal_I + 40)] = sigma;
    }
    if ((mi_hi & 0x0020) !=0)        m_IK1306.L = m_IK1306.P & 1;
    if ((mi_hi & 0x0010) !=0)        m_IK1306.pM[signal_I] = m_IK1306.S;
//---------------------------------------------------------

    if((mi_hi & 0x0040) == 0){
      // 6 bit == 0, может быть 7 бит не равен?
      if((mi_hi & 0x0080) != 0)  m_IK1306.S = sigma; // 7 bit == 1
    }
    else{
      // 6 bit == 1, может быть 7 бит тоже равен?
      m_IK1306.S = m_IK1306.S1;
      if((mi_hi & 0x0080) != 0) m_IK1306.S |= sigma;
    }

    // 6 bit == 0, нам пофиг на состояние 7 бита
    if((mi_hi & 0x0100) != 0){
      // 6 bit == 1, может быть 7 бит тоже равен?
      if((mi_hi & 0x0200) != 0) m_IK1306.S1 |= sigma; else m_IK1306.S1 = sigma;
    }
//----------------------------------------------------------
    mi_hi = mi_hi & 0x0C00;
    if(mi_hi != 0){
          if(mi_hi == 0x0400){
                    m_IK1306.ST[MOD42(signal_I + 2)] = m_IK1306.ST[MOD42(signal_I + 1)];
                    m_IK1306.ST[MOD42(signal_I + 1)] = m_IK1306.ST[signal_I];
                    m_IK1306.ST[signal_I] = sigma;
          }
          else if(mi_hi == 0x0800){
                    tmp = m_IK1306.ST[signal_I];
                    m_IK1306.ST[signal_I] = m_IK1306.ST[MOD42(signal_I + 1)];
                    m_IK1306.ST[MOD42(signal_I + 1)] = m_IK1306.ST[MOD42(signal_I + 2)];
                    m_IK1306.ST[MOD42(signal_I + 2)] = tmp;
          }
    }
}

/**
 * mk61emu
 */

void MK61Emu_Cleanup() {
    for(usize i=0; i < (42+41); i++) mod42_table[i] = i%42;
    memset(&ringM,0,sizeof(ringM));
    IK1302_Clear();
    IK1303_Clear();
    IK1306_Clear();
}

void MK61Emu_SetKeyPress(const int key1, const int key2) {
    m_IK1302.key_x = key1;
    m_IK1302.key_y = key2;
}

void MK61Emu_SetDisplayed(uint32_t value) {
    m_IK1302.displayed = value;
}

uint32_t MK61Emu_GetDisplayed(void) {
    return m_IK1302.displayed;
}

inline uint32_t MK61Emu_GetComma(void) {
    return m_IK1302.comma;
}

bool MK61Emu_IsRunning(void) {
    if (m_IK1302.comma == 11) {
        return true;
    }
    return false;
}

void MK61Emu_SetAngleUnit(AngleUnit angle) {
    m_emu.m_angle_unit = angle;
}

AngleUnit MK61Emu_GetAngleUnit(void) {
    return m_emu.m_angle_unit;
}

/*

void  read_Y(char* buffer, const char* display_symbols) { // считывает в буфер регистра стека
  bool lider_zero = true;
  for(int i=580-33+24; i >= 580-33; i-=3) {
    const u8 digit = ringM[i];
    if(digit == 0 && lider_zero) {
      lider_zero = false;
    } else {
      *buffer++ = display_symbols[digit];
    }
  }
}

void    MK61Emu_SetStackStr(StackRegister stack_reg, char sign, char mantissa[8], isize pow) {
  isize addr = (isize) stack_reg;
  if(pow < 0) {
    pow += 100;
    ringM[addr] = 9;
  } else {
    ringM[addr] = 0;
  }
  addr -= 3;
  ringM[addr] = pow / 10;
  addr -= 3;
  ringM[addr] = pow % 10;
  addr -= 3;
  ringM[addr] = (sign == '-')? 9 : 0;

  for(isize i=0; i<8; i++) {
    addr -= 3;
    ringM[addr] = mantissa[i] - '0';
  }
}*/

void write_stack_register(stack reg, char sign, char cmantissa[8], isize pow) {
  isize addr = (isize) reg + 1;
  // mantissa convert
  for(isize i=7; i >= 0; i--) {
    ringM[addr] = cmantissa[i] - '0';
    addr += 3;
  }
  // pow convert
  ringM[addr] = (sign == '-')? 9 : 0;
  if(pow < 0) {
    pow += 100;
    ringM[addr + 9] = 9;
  } else {
    ringM[addr + 9] = 0;
  }
  ringM[addr + 6] = pow / 10;
  ringM[addr + 3] = pow % 10;
}

/*
 buffer 012345678901234
        -1.2345678 -99
*/
const char* read_stack_register(stack reg, char cvalue[15], const char* symbols_set) {
  // mantissa convert
  usize i = (usize) reg + 1;
  isize pos = 9;
  do {
    if(pos == 2) cvalue[pos--] = '.';
    cvalue[pos--] = symbols_set[ringM[i]];
    i += 3;
  } while(pos > 0);
  cvalue[0] = (ringM[i] == 9)? '-' : ' ';
  // pow convert
  cvalue[10] = ' ';
  const usize powl = ringM[i + 3];
  const usize powh = ringM[i + 6];
  if(ringM[i + 9] == 9) {
    cvalue[11] = '-';
    const usize pow = 100 - (powh*10 + powl);
    cvalue[12] = symbols_set[pow / 10];
    cvalue[13] = symbols_set[pow % 10];
  } else {
    cvalue[11] = ' ';
    cvalue[12] = symbols_set[powh];
    cvalue[13] = symbols_set[powl];
  }

  return &cvalue[0];
}
/*
const char* MK61Emu_GetStackStr(StackRegister stack_reg, const char* symbols_set) {
    char *reg_stack;
    if (stack_reg == REG_Y) {
        reg_stack = m_emu.m_stack_y_str;
    }
    else {
        reg_stack = m_emu.m_stack_z_str;
    }

    memset(reg_stack, 0, INDICATOR_STRING_LENGTH);
    memset(reg_stack, ' ', INDICATOR_STRING_LENGTH - 3);

     // Формат числа:
    uint16_t tail_address = (uint16_t)stack_reg; // Смещение последнего байта экспоненты

    // Собираем порядок числа
    int16_t exp_value = ringM[tail_address - 3] * 10 + ringM[tail_address - 6];
    if (ringM[tail_address] == 9) {
        exp_value = -(100 - exp_value);
    }

    // Собираем мантиссу
    int i = 0;
    while (ringM[tail_address - 33 + i * 3] == 0) {
        if (exp_value == 7 - i || i == 7) {
            break;
        }
        i++;
    }

    uint8_t digits[8];
    memset(digits, 0, 8);
    int digits_len = 0;
    int j = 8 - i;
    while (i < 8)
    {
        digits[--j] = ringM[tail_address - 33 + i * 3];
        digits_len++;
        i++;
    }

    reg_stack[0] = (ringM[tail_address - 9] == 9) ? '-' : ' ';

    bool has_point = false;
    j = 1;
    for (i = 0; i < digits_len; i++) {
        reg_stack[j++] = symbols_set[digits[i]];
        if ((i == 0 && (exp_value < 0 || exp_value > 7)) || (i == exp_value)) {
            reg_stack[j++] = '.';
            has_point = true;
        }
    }

    if (!has_point) {
        reg_stack[i] = '.';
    }

    if (exp_value < 0 || exp_value > 7) {
        if (exp_value < 0) {
            reg_stack[10] = '-';
            exp_value = -exp_value;
        }

        reg_stack[11] = symbols_set[exp_value / 10];
        reg_stack[12] = symbols_set[exp_value % 10];
    }
    else {
        memset((reg_stack + 11), ' ', 3);
    }

    return reg_stack;
}*/


//                                           mantisa                   |    pow
//                                       0   1   2   3   4  5  6  7  8   9  10  11
static const usize indicator_pos[12] = {24, 21, 18, 15, 12, 9, 6, 3, 0, 33, 30, 27};
namespace core_61 {

static  usize   backstep_comma_position;

void step(void) {
    m_IK1303.key_y = 1;
    m_IK1303.key_x = m_emu.m_angle_unit;
    ::cycle();
    m_IK1302.key_x = 0;
    m_IK1302.key_y = 0;
}

void enable(void) {
    MK61Emu_Cleanup();
    //MK61Emu_SetAngleUnit(RADIAN);
    core_61::clear_displayed();
    backstep_comma_position = core_61::comma_position();
    step();
}

bool  update_indicator(char* buffer, const char* display_symbols) { // возращает false - есть изменения в дисплейной строке/ true - нет изменений
  const isize  comma_pos = 9 - m_IK1302.comma + 1;
  bool match = true;

  isize i = 0;
  while(i < comma_pos) {
    const char read_char = display_symbols[ m_IK1302.R[ indicator_pos[i++] ] ];

    match = (*buffer == read_char);
    if(match) {
      buffer++;
    } else {
      *buffer++ = read_char;
      while(i < comma_pos) {
        const char read_char = display_symbols[ m_IK1302.R[ indicator_pos[i++] ] ];
        *buffer++ = read_char; 
      }
      break;
    }
  }

  if(i == comma_pos) *buffer++ = '.';

  while(i < 12) {
    const char read_char = display_symbols[ m_IK1302.R[ indicator_pos[i++] ] ];

    match &= (*buffer == read_char);
    if(match) {
      buffer++;
    } else {
      *buffer++ = read_char;
      while(i < 12) {
        const char read_char = display_symbols[ m_IK1302.R[ indicator_pos[i++] ] ];
        *buffer++ = read_char; 
      }
      break;
    }
  }
  *buffer = 0;

  return match;
}

}
//                   1--------12--------23--- 
//          123456789012345678901234567890123
//   nReg*42
//     ----7--6--5--4--3--2--1--0--S--1--0--s
//   { sign_num|sign_pow|len, abs(pow), mantissa... }

u8* MK61Emu_UnpackRegster(u8 nReg, u8 *pack_number) {
  //const u8 nReg = *pack_number++;
  const i8 sign = *pack_number & 0b11000000;
  const u8 len  = *pack_number++ & 0b00111111;
  const u8 pow  = *pack_number++;
  const int cnt_zero = len * 2;
  int   addr = nReg*42 + 21;
  u8    two_digits = 0;

      ringM[addr + 3] = (sign < 0)? 9 : 0;
      if((sign & 0b01000000) != 0) {
        ringM[addr + 3*4] = 9;
      } else {
        ringM[addr + 3*4] = 0;
      }

      for(int j = 0; j < 8; j++){
        if(j >= cnt_zero) {
          ringM[addr] = 0; 
        } else {
          if ((j & 1) == 0) { // четные цифры
            two_digits = *pack_number++;
            ringM[addr] = two_digits >> 4;
          } else { // нечетные цифры
            ringM[addr] = two_digits & 0xF; 
          }
        }
        addr -= 3;
      }  

    ringM[addr + 27 + 3] = pow & 0xF; 
    ringM[addr + 30 + 3] = pow >> 4;
    
  return pack_number;
}

void    MK61Emu_WriteRegister(int nReg, char* buffer) {
  int addr = nReg*42 + 21;

    for(int j = 3; j < 11; j++){
      ringM[addr] = *buffer++ - '0'; 
      addr -= 3;
    }  

    buffer++;
    ringM[addr+30+3] = *buffer++ - '0'; 
    ringM[addr+27+3] = *buffer++ - '0'; 
}
/*
char    digit_as_MK61(u8 digit_hex) {
  static const char MK61_HEX_DIGITS[6] = {'-','L','C','\303','E',' '};
  if(digit_hex <= 9) 
    return ('0' | digit_hex);
  else if(digit_hex > 9 && digit_hex <= 0xF)
    return MK61_HEX_DIGITS[digit_hex - 10];
  else
    return '?';
}
*/
//      0       1      2     3
// 24, 21, 18, 15, 12, 9, 6, 3, 0 ::: 33, 30, 27
void    MK61Emu_ReadRegister(int nReg, char* buffer, const char* display_symbols) {
  int addr = nReg*42 + 21;
  const u8 sign_pow_tetra = ringM[addr + 3*4];
  const bool sign_pow = ringM[addr + 3*4];
  const bool sign_val = ringM[addr + 3];

  *buffer++ = (sign_val)? '-' : ' ';

  dbghex(MK61E, (isize) ringM[addr+3], ','); 

  for(int j = 3; j < 11; j++){
    *buffer++ = display_symbols[ringM[addr]]; 
    dbghex(MK61E, (isize) ringM[addr], ',');
    if(j == 3) *buffer++ = '.';
    addr -= 3;
  }  
  *buffer++ = ' ';

  dbghex(MK61E, 'E', (isize) ringM[sign_pow_tetra], ',');
  dbghex(MK61E, (isize) ringM[addr+30+3], ','); 
  dbghex(MK61E, (isize) ringM[addr+27+3], '|'); 

  if(sign_pow != 0) {
    *buffer++ = '-';
    const usize pow = 100 - ringM[addr+30+3]*10 - ringM[addr+27+3];
    *buffer++ = display_symbols[pow / 10]; 
    *buffer++ = display_symbols[pow % 10]; 
  } else {
    *buffer++ = ' ';
    *buffer++ = display_symbols[ringM[addr+30+3]]; 
    *buffer++ = display_symbols[ringM[addr+27+3]]; 
  }
  *buffer = 0x00;
}

usize   MK61Emu_Read_R_mantissa(usize nReg) {
  usize addr = nReg*42 + 21;
  usize value = 0;
  for(usize j = 3; j < 11; j++){
    value = (value * 10) + ringM[addr]; 
    addr -= 3;
  } 
  
  return value;
}

usize MK61Emu_Read_X_as_byte(void) {
  isize num = 0;
    for(isize i = 21; i >= 12 ; i -= 3) {
      const int digit = m_IK1302.R[i];
      if(digit <= 9) num = num*10 + digit; else break;
      if(num > 256) break;
    }

  return num;
}

uint8_t MK61Emu_GetCode(int addr){
    return (ringM[addr]<<4)|(ringM[addr-3]);
}

void MK61Emu_SetCode(int addr, uint8_t data) {
    ringM[addr] = data >> 4;
    ringM[addr-3] = data & 0x0F;
}

void  MK61Emu_GetCodePage(uint8_t* page) {
  for(usize i = 41; i < SIZE_RING_M/*672*/; i+=42) {
    *page++ = MK61Emu_GetCode(i);
    usize addr = i - 36;
    while(addr < i) {
          *page++ = MK61Emu_GetCode(addr);
          addr += 6;
    }
  }
}

void  MK61Emu_ClearCodePage(void) {
    for(usize i = 41; i < SIZE_RING_M/*672*/; i+=42) {
      MK61Emu_SetCode(i, 0);
      for(usize addr=i-36; addr < i; addr+=6) {
        MK61Emu_SetCode(addr, 0);
      }
    }
}

void MK61Emu_get_1302_R(char* buff) {
  for(int i=0; i < IK13_MTICK_COUNT; i++) {
    const uint8_t nibl = m_IK1302.R[i];
    buff[i] = (char) (nibl < 10)? nibl + '0' : nibl - 10 + 'A';
  }
  buff[42] = 0;
}

int MK61Emu_GetDisplayReg(void) {
  int num = 0;
    for(int i = 21; i >= 0 ; i -= 3) {
      const int digit = m_IK1302.R[i];
      #ifdef DEBUG
        Serial.print(digit); Serial.print(",");
      #endif
      if(digit <= 9) num = num*10 + digit; else break;
    }
    #ifdef DEBUG
      Serial.println(num);
    #endif

  return num;
}

const char* MK61Emu_GetIndicatorStr(const char* display_symbols) {
    uint16_t i = 0;

    memset(m_emu.m_indicator_str, 0, 15);
    memset(m_emu.m_indicator_str, ' ', 12);

    for (i = 0; i < 9; i++) {
        m_emu.m_indicator_str[i] = display_symbols[m_IK1302.R[(8 - i) * 3]];
    }
    for (i = 0; i < 3; i++) {
        m_emu.m_indicator_str[i + 10] = display_symbols[m_IK1302.R[(11 - i) * 3]];
    }

    int comma_pos = 9 - m_IK1302.comma + 1;
    for (i = 13; i >= comma_pos; i--) {
        m_emu.m_indicator_str[i] = m_emu.m_indicator_str[i - 1];
    }

    m_emu.m_indicator_str[comma_pos] = ',';
    return m_emu.m_indicator_str;
}
